## conf/layer.conf
```bitbake
# We have a conf and classes directory, add to BBPATH
BBPATH .= ":${LAYERDIR}"

# We have recipes-* directories, add to BBFILES
BBFILES += "${LAYERDIR}/recipes-*/*/*.bb \
${LAYERDIR}/recipes-*/*/*.bbappend"

BBFILE_COLLECTIONS += "qatest-layer"
BBFILE_PATTERN_qatest-layer = "^${LAYERDIR}/"
BBFILE_PRIORITY_qatest-layer = "7"

# This should only be incremented on significant changes that will
# cause compatibility issues with other layers
LAYERVERSION_qatest-layer = "1"

LAYERDEPENDS_qatest-layer = "core openembedded-layer meta-python"
```

## meta-qa-framework/conf/layer.conf
```bitbake
# We have a conf and classes directory, add to BBPATH
BBPATH .= ":${LAYERDIR}"

# We have recipes-* directories, add to BBFILES
BBFILES += "${LAYERDIR}/recipes-*/*/*.bb \
${LAYERDIR}/recipes-*/*/*.bbappend"

BBFILE_COLLECTIONS += "qa-framework-layer"
BBFILE_PATTERN_qa-framework-layer = "^${LAYERDIR}/"
BBFILE_PRIORITY_qa-framework-layer = "7"

# This should only be incremented on significant changes that will
# cause compatibility issues with other layers
LAYERVERSION_qa-framework-layer = "1"
LAYERSERIES_COMPAT_qa-framework-layer = "dunfell"
LAYERDEPENDS_qa-framework-layer = "core openembedded-layer meta-python"
```

## meta-qa-testsuites/conf/layer.conf
```bitbake
# We have a conf and classes directory, add to BBPATH
BBPATH .= ":${LAYERDIR}"

# We have recipes-* directories, add to BBFILES
BBFILES += "${LAYERDIR}/recipes-*/*/*.bb \
${LAYERDIR}/recipes-*/*/*.bbappend"

BBFILE_COLLECTIONS += "qa-testsuites-layer"
BBFILE_PATTERN_qa-testsuites-layer = "^${LAYERDIR}/"
BBFILE_PRIORITY_qa-testsuites-layer = "7"
LAYERSERIES_COMPAT_qa-testsuites-layer = "dunfell"
LAYERDEPENDS_qa-testsuites-layer = " qa-framework-layer"
```
